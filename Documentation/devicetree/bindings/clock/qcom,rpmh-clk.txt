## Documentation/devicetree/bindings/clock/qcom,rpmh-clk.txt
```
Qualcomm Technologies, Inc. RPMh Clocks
-------------------------------------------------------

Resource Power Manager Hardened (RPMh) manages shared resources on
some Qualcomm Technologies Inc. SoCs. It accepts clock requests from
other hardware subsystems via RSC to control clocks.

Required properties :
- compatible : shall contain "qcom,rpmh-clk-sdm845"

- #clock-cells : must contain 1

Example :

#include <dt-bindings/clock/qcom,rpmh.h>

	&apps_rsc {
		rpmh: clock-controller {
			compatible = "qcom,rpmh-clk-sdm845";
			#clock-cells = <1>;
		};
	};
```

## Documentation/devicetree/bindings/devfreq/icbw.txt
```
Interconnect bandwidth device

icbw is a device that represents an interconnect path that connects two
devices. This device is typically used to vote for BW requirements between
two devices. Eg: CPU to DDR, GPU to DDR, etc. This device is expected to
use passive govenor by default.

Required properties:
- compatible:		Must be "devfreq-icbw"
- interconnects:	Pairs of phandles and interconnect provider specifier
			to denote the edge source and destination ports of
			the interconnect path. See also:
		Documentation/devicetree/bindings/interconnect/interconnect.txt
- operating-points-v2:	A phandle to an OPP v2 table that holds frequency,
			bandwidth values (in MB/s) and required-opp's populated
			with phandles pointing to the required per cpu opp. The
			bandwidth (in MB/s) values depend on multiple properties
			of the interconnect path like frequency, interconnect
			width, etc.

Example:

cpus {
	...

	CPU0: cpu@0 {
		...
		operating-points-v2 = <&cpu0_opp_table>;
		...
	};

	CPU1: cpu@100 {
		...
		operating-points-v2 = <&cpu0_opp_table>;
		...
	};

	CPU2: cpu@200 {
		...
		operating-points-v2 = <&cpu0_opp_table>;
		...
	};

	CPU3: cpu@300 {
		...
		operating-points-v2 = <&cpu0_opp_table>;
		...
	};

	CPU4: cpu@400 {
		...
		operating-points-v2 = <&cpu4_opp_table>;
		...
	};

	CPU5: cpu@500 {
		...
		operating-points-v2 = <&cpu4_opp_table>;
		...
	};

	CPU6: cpu@600 {
		...
		operating-points-v2 = <&cpu4_opp_table>;
		...
	};

	CPU7: cpu@700 {
		...
		operating-points-v2 = <&cpu4_opp_table>;
		...
	};
};

cpu0_opp_table: cpu0_opp_table {
	compatible = "operating-points-v2";
	opp-shared;

	cpu0_opp1: opp-300000000 {
		opp-hz = /bits/ 64 <300000000>;
	};

	...

	cpu0_opp16: opp-1612800000 {
		opp-hz = /bits/ 64 <1612800000>;
	};

	...
};

cpu4_opp_table: cpu4_opp_table {
	compatible = "operating-points-v2";
	opp-shared;

	...

	cpu4_opp4: opp-1056000000 {
		opp-hz = /bits/ 64 <1056000000>;
	};

	cpu4_opp5: opp-1209600000 {
		opp-hz = /bits/ 64 <1209600000>;
	};

	...
};

bw_opp_table: bw-opp-table {
	compatible = "operating-points-v2";

	opp-200  {
		opp-hz = /bits/ 64 < 200000000 >; /* 200 MHz */
		required-opps = <&cpu0_opp1>;
		/* 0 MB/s average and 762 MB/s peak bandwidth */
		opp-bw-MBs = <0 762>;
	};

	opp-300 {
		opp-hz = /bits/ 64 < 300000000 >; /* 300 MHz */
		/* 0 MB/s average and 1144 MB/s peak bandwidth */
		opp-bw-MBs = <0 1144>;
	};

	...

	opp-768 {
		opp-hz = /bits/ 64 < 768000000 >; /* 768 MHz */
		/* 0 MB/s average and 2929 MB/s peak bandwidth */
		opp-bw-MBs = <0 2929>;
		required-opps = <&cpu4_opp4>;
	};

	opp-1017 {
		opp-hz = /bits/ 64 < 1017000000 >; /* 1017 MHz */
		/* 0 MB/s average and 3879 MB/s peak bandwidth */
		opp-bw-MBs = <0 3879>;
		required-opps = <&cpu0_opp16>, <&cpu4_opp5>;
	};
};

cpubw {
	compatible = "devfreq-icbw";
	interconnects = <&snoc MASTER_APSS_1 &bimc SLAVE_EBI_CH0>;
	operating-points-v2 = <&bw_opp_table>;
};
```

## Documentation/devicetree/bindings/interconnect/qcom,sdm845.txt
```
Qualcomm SDM845 Network-On-Chip interconnect driver binding
-----------------------------------------------------------

SDM845 interconnect providers support system bandwidth requirements through
RPMh hardware accelerators known as Bus Clock Manager (BCM) and L3 bandwidth
requirements through Operation State Manager (OSM). The provider is able to
communicate with the BCM through the Resource State Coordinator (RSC) associated
with each execution environment. The RSC provider nodes must reside within an
RPMh device node pertaining to their RSC and each provider maps to a single RPMh
resource.

Required properties :
- compatible : shall contain only one of the following:
			"qcom,sdm845-rsc-hlos"
			"qcom,sdm845-osm-l3"

- clocks
	Usage:		required for "qcom,sdm845-osm-l3"
	Value type:	<phandle> From common clock binding.
	Definition:	clock handle for XO clock and GPLL0 clock.

- clock-names
	Usage:		required for "qcom,sdm845-osm-l3"
	Value type:	<string> From common clock binding.
	Definition:	must be "xo", "alternate".

- reg
	Usage:		required for "qcom,sdm845-osm-l3"
	Value type:	<prop-encoded-array>
	Definition:	Address and size of the OSM L3 memory base.

- #interconnect-cells : should contain 1

Examples:

apps_rsc: rsc {
	rsc_hlos: interconnect {
		compatible = "qcom,sdm845-rsc-hlos";
		#interconnect-cells = <1>;
	};
};

osm_l3: interconnect@17d41000 {
	compatible = "qcom,sdm845-osm-l3";
	reg = <0 0x17d41000 0 0x1400>;

	clocks = <&rpmhcc RPMH_CXO_CLK>, <&gcc GPLL0>;
	clock-names = "xo", "alternate";

	#interconnect-cells = <1>;
};
```

## Documentation/devicetree/bindings/regulator/qcom,rpmh-regulator.txt
```
Qualcomm Technologies, Inc. RPMh Regulators

rpmh-regulator devices support PMIC regulator management via the VRM and XOB
RPMh accelerators.  The APPS processor communicates with these hardware blocks
via an RSC using command packets.  The VRM allows changing four parameters for a
given regulator: enable state, output voltage, operating mode, and minimum
headroom voltage.  The XOB allows changing only a single parameter for a given
regulator: its enable state.

=======================
Required Node Structure
=======================

RPMh regulators must be described in two levels of device nodes.  The first
level describes the PMIC containing the regulators and must reside within an
RPMh device node.  The second level describes each regulator within the PMIC
which is to be used on the board.  Each of these regulators maps to a single
RPMh resource.

The names used for regulator nodes must match those supported by a given PMIC.
Supported regulator node names:
	PM8998:		smps1 - smps13, ldo1 - ldo28, lvs1 - lvs2
	PMI8998:	bob
	PM8005:		smps1 - smps4

==================================
First Level Nodes - PMIC
==================================

- compatible
	Usage:      required
	Value type: <string>
	Definition: Must be one of: "qcom,pm8998-rpmh-regulators",
		    "qcom,pmi8998-rpmh-regulators" or
		    "qcom,pm8005-rpmh-regulators".

- qcom,pmic-id
	Usage:      required
	Value type: <string>
	Definition: RPMh resource name suffix used for the regulators found on
		    this PMIC.  Typical values: "a", "b", "c", "d", "e", "f".

- vdd_s1-supply
- vdd_s2-supply
- vdd_s3-supply
- vdd_s4-supply
- vdd_s5-supply
- vdd_s6-supply
- vdd_s7-supply
- vdd_s8-supply
- vdd_s9-supply
- vdd_s10-supply
- vdd_s11-supply
- vdd_s12-supply
- vdd_s13-supply
- vdd_l1_l27-supply
- vdd_l2_l8_l17-supply
- vdd_l3_l11-supply
- vdd_l4_l5-supply
- vdd_l6-supply
- vdd_l7_l12_l14_l15-supply
- vdd_l9-supply
- vdd_l10_l23_l25-supply
- vdd_l13_l19_l21-supply
- vdd_l16_l28-supply
- vdd_l18_l22-supply
- vdd_l20_l24-supply
- vdd_l26-supply
- vdd_lvs1_lvs2-supply
- vdd_lvs1_lvs2-supply
	Usage:      optional (PM8998 only)
	Value type: <phandle>
	Definition: phandle of the parent supply regulator of one or more of the
		    regulators for this PMIC.

- vdd_bob-supply
	Usage:      optional (PMI8998 only)
	Value type: <phandle>
	Definition: phandle of the parent supply regulator of one or more of the
		    regulators for this PMIC.

- vdd_s1-supply
- vdd_s2-supply
- vdd_s3-supply
- vdd_s4-supply
	Usage:      optional (PM8005 only)
	Value type: <phandle>
	Definition: phandle of the parent supply regulator of one or more of the
		    regulators for this PMIC.

=========================================
Second Level Nodes - Regulators
=========================================

- regulator-name
	Usage:      optional
	Value type: <string>
	Definition: Specifies the name for this RPMh regulator.  If not
		    specified, then the regulator's name is equal to its subnode
		    name.

- regulator-min-microvolt
	Usage:      required
	Value type: <u32>
	Definition: For VRM resources, this is the minimum supported voltage in
		    microvolts.  For XOB resources, this is the fixed output
		    voltage.

- regulator-max-microvolt
	Usage:      required
	Value type: <u32>
	Definition: For VRM resources, this is the maximum supported voltage in
		    microvolts.  For XOB resources, this is the fixed output
		    voltage.

- qcom,regulator-initial-voltage
	Usage:      optional; VRM regulators only
	Value type: <u32>
	Definition: Specifies the initial voltage in microvolts to request for a
		    VRM regulator.  Supported values are 0 to 8191000.

- regulator-initial-mode
	Usage:      optional; VRM regulators only
	Value type: <u32>
	Definition: Specifies the initial mode to request for a VRM regulator.
		    Supported values are RPMH_REGULATOR_MODE_* which are defined
		    in [1] (i.e. 0 to 4).

- regulator-allow-set-load
	Usage:      optional
	Value type: <empty>
	Definition: Boolean flag indicating that the the mode of this regulator
		    may be configured at runtime based upon consumer load needs.

- qcom,allowed-modes
	Usage:      required if regulator-allow-set-load is specified;
		    VRM regulators only
	Value type: <prop-encoded-array>
	Definition: A list of integers specifying the PMIC regulator modes which
		    can be configured at runtime based upon consumer load needs.
		    Supported values are RPMH_REGULATOR_MODE_* which are defined
		    in [1] (i.e. 0 to 4).  Elements must be specified in order
		    from lowest to highest value.

- qcom,mode-threshold-currents
	Usage:      required if regulator-allow-set-load is specified;
		    VRM regulators only
	Value type: <prop-encoded-array>
	Definition: A list of integers specifying the minimum allowed load
		    current in microamps for each of the modes listed in
		    qcom,allowed-modes.  The first element should always be 0.
		    Elements must be specified in order from lowest to highest
		    value.

- qcom,headroom-voltage
	Usage:      optional; VRM regulators only
	Value type: <u32>
	Definition: Specifies the headroom voltage in microvolts to request for
		    a VRM regulator.  RPMh hardware automatically ensures that
		    the parent of this regulator outputs a voltage high enough
		    to satisfy the requested headroom.  Supported values are
		    0 to 511000.

 - regulator-enable-ramp-delay
	Usage:      optional
	Value type: <u32>
	Definition: The time in microseconds to delay after enabling a
		    regulator.  Note that RPMh hardware ensures that regulator
		    output has stabilized before acknowledging a given regulator
		    enable request.

- qcom,rpmh-resource-type
	Usage:      optional
	Value type: <string>
	Definition: RPMh accelerator type for this regulator.  If not specified,
		    then the default type associated with this regulator will be
		    used.  Supported values: "vrm" or "xob".

- qcom,always-wait-for-ack
	Usage:      optional
	Value type: <empty>
	Definition: Boolean flag which indicates that the application processor
		    must wait for an ACK or a NACK from RPMh for every request
		    sent for this regulator including those which are for a
		    strictly lower power state.

Other properties defined in regulator.txt may also be used.

[1] include/dt-bindings/regulator/qcom,rpmh-regulator.h

========
Examples
========

#include <dt-bindings/regulator/qcom,rpmh-regulator.h>

&apps_rsc {
	pm8998-rpmh-regulators {
		compatible = "qcom,pm8998-rpmh-regulators";
		qcom,pmic-id = "a";

		vdd_l7_l12_l14_l15-supply = <&pm8998_s5>;

		smps2 {
			regulator-min-microvolt = <1100000>;
			regulator-max-microvolt = <1100000>;
			qcom,regulator-initial-voltage = <1100000>;
		};

		pm8998_s5: smps5 {
			regulator-min-microvolt = <1904000>;
			regulator-max-microvolt = <2040000>;
			qcom,regulator-initial-voltage = <1904000>;
		};

		ldo7 {
			regulator-min-microvolt = <1800000>;
			regulator-max-microvolt = <1800000>;
			qcom,regulator-initial-voltage = <1800000>;
			qcom,headroom-voltage = <56000>;
			regulator-initial-mode = <RPMH_REGULATOR_MODE_LPM>;
			regulator-allow-set-load;
			qcom,allowed-modes =
				<RPMH_REGULATOR_MODE_LPM
				 RPMH_REGULATOR_MODE_HPM>;
			qcom,mode-threshold-currents = <0 10000>;
		};

		lvs1 {
			regulator-min-microvolt = <1800000>;
			regulator-max-microvolt = <1800000>;
		};
	};

	pmi8998-rpmh-regulators {
		compatible = "qcom,pmi8998-rpmh-regulators";
		qcom,pmic-id = "b";

		bob {
			regulator-min-microvolt = <3312000>;
			regulator-max-microvolt = <3600000>;
			qcom,regulator-initial-voltage = <3312000>;
			regulator-initial-mode = <RPMH_REGULATOR_MODE_PASS>;
		};
	};
};
```

## Documentation/devicetree/bindings/regulator/qpnp-labibb-regulator.txt
```
QTI's LAB (LCD/AMOLED BOOST)/IBB (Inverting Buck-Boost) Regulator

LAB can be used as a standalone positive boost power supply for general purpose
applications. IBB can be used as a standalone negative power supply for general
applications. Also, LAB and IBB can be used together to provide power supply for
display panels, LCD or AMOLED.

Main node required properties:

- compatible:			Must be "qcom,qpnp-labibb-regulator"

LAB subnode required properties:

- reg:				Specifies the SPMI address and size for this peripheral.
- reg-names:			Register names. Must be "lab".
- regulator-name:		A string used to describe the regulator.
- interrupts:				Specify the interrupts as per the interrupt
					encoding.
					Currently "lab-vreg-ok" is required and "lab-sc_err"
					is optional for LCD mode in pmi8998.
					For AMOLED mode, "lab-vreg-ok" is required
					only when SWIRE control is enabled and skipping
					2nd SWIRE pulse is required in pmi8952/8996.
- interrupt-names:			Interrupt names to match up 1-to-1 with
					the interrupts specified in 'interrupts'
					property.

IBB subnode required properties:

- reg:				Specifies the SPMI address and size for this peripheral.
- reg-names:			Register names. Must be "ibb".
- regulator-name:		A string used to describe the regulator.
- qcom,qpnp-ibb-init-voltage:	The default initial voltage when the bootloader does
				not turn on IBB regulator.

IBB subnode optional properties:

- interrupts:				Specify the interrupts as per the interrupt
					encoding.
					Currently "ibb-sc-err" could be used for LCD mode
					in pmi8998 to detect the short circuit fault.
- interrupt-names:			Interrupt names to match up 1-to-1 with
					the interrupts specified in 'interrupts'
					property.
- qcom,qpnp-ibb-lab-pwrup-delay:	Power up delay (in us) for IBB regulator when
					it is enabled or turned on. Supported values
					are 1000, 2000, 4000 and 8000.
- qcom,qpnp-ibb-en-discharge:			A boolean property which upon set will
						enable discharge for IBB regulator.
						Otherwise, it is kept disabled.
Example:
	qcom,pmi8994@3 {
		qpnp-labibb-regulator {
			compatible = "qcom,qpnp-labibb-regulator";
			#address-cells = <1>;
			#size-cells = <1>;

			lab_regulator: qcom,lab@de00 {
				reg = <0xde00 0x100>;
				reg-names = "lab";

				interrupts = <0x3 0xde 0x0
						IRQ_TYPE_EDGE_RISING>;
                                interrupt-names = "lab-vreg-ok";

				regulator-name = "lab_reg";
				
			};

			ibb_regulator: qcom,ibb@dc00 {
				reg = <0xdc00 0x100>;
				reg-names = "ibb_reg";
				regulator-name = "ibb_reg";

				interrupt-names = "ibb-sc-err";
                                qcom,qpnp-ibb-init-voltage = <5500000>;
                                qcom,qpnp-ibb-lab-pwrup-delay = <8000>;
                                qcom,qpnp-ibb-en-discharge;
			};

		};
	};
```
